## drivers/input/fingerprint/Kconfig
```kconfig
config INPUT_FINGERPRINT
	tristate "Fingerprint driver support"
	help
	  Say Y here to enable fingerprint driver support

source "drivers/input/fingerprint/fpc/Kconfig"
source "drivers/input/fingerprint/goodix/Kconfig"
```

## drivers/input/fingerprint/fpc/Kconfig
```kconfig
config FINGERPRINT_FPC1020
	tristate "FingerPrint Cards fingerprint driver support"
	depends on INPUT_FINGERPRINT
	help
	  Say Y here to enable fpc fingerprint driver support!
```

## drivers/input/touchscreen/xiaomi/Kconfig
```kconfig
if MACH_XIAOMI_MSM8953

source "drivers/input/touchscreen/xiaomi/vince/Kconfig"

endif
```

## drivers/input/touchscreen/xiaomi/daisy-sakura/Kconfig
```kconfig
if MACH_XIAOMI_DAISY

source "drivers/input/touchscreen/xiaomi/daisy-sakura/ft5446/Kconfig"
source "drivers/input/touchscreen/xiaomi/daisy-sakura/gt917d/Kconfig"

endif

if MACH_XIAOMI_SAKURA

source "drivers/input/touchscreen/xiaomi/daisy-sakura/ft5446/Kconfig"
source "drivers/input/touchscreen/xiaomi/daisy-sakura/gt917d/Kconfig"

endif
```

## drivers/input/touchscreen/xiaomi/vince/Kconfig
```kconfig
if MACH_XIAOMI_VINCE

source "drivers/input/touchscreen/xiaomi/vince/nt36672/Kconfig"

source "drivers/input/touchscreen/xiaomi/vince/td4310_e7/Kconfig"

source "drivers/input/touchscreen/xiaomi/vince/td4310_lansi_e7/Kconfig"

source "drivers/input/touchscreen/xiaomi/vince/vituralsar/Kconfig"

endif
```

## drivers/input/touchscreen/xiaomi/vince/td4310_e7/Kconfig
```kconfig
#
# Synaptics DSX touchscreen driver configuration
#

config TOUCHSCREEN_TD4310_E7
	tristate "synaptics touchscreens"
	depends on I2C
	help
	  Say Y here if you have a ist3038c touchscreen.
	  Ft5x06 controllers are multi touch controllers which can
	  report 5 touches at a time.

	  If unsure, say N.

	  To compile this driver as a module, choose M here: the
	  module will be called ist3038c_ts.
```

## drivers/platform/xiaomi/Kconfig
```kconfig
# Xiaomi configuration options

config MACH_XIAOMI_MSM8953
	bool "Xiaomi MSM8953 devices"
	help
	  Support for Xiaomi MSM8953 variants

menu "Xiaomi MSM8953 board selection"

config MACH_XIAOMI_DAISY
        bool "xiaomi daisy board"
        select MACH_XIAOMI_MSM8953
        help
          Support for Xiaomi Mi A2 Lite

config MACH_XIAOMI_MIDO
        bool "xiaomi mido board"
        select MACH_XIAOMI_MSM8953
        help
          Support for Xiaomi Redmi Note 4

config MACH_XIAOMI_ONC
        bool "xiaomi onc board"
        select MACH_XIAOMI_MSM8953
        help
          Support for Xiaomi Redmi Y3

config MACH_XIAOMI_ROSY
        bool "xiaomi rosy board"
        select MACH_XIAOMI_MSM8953
        help
          Support for Xiaomi Redmi 5

config MACH_XIAOMI_SAKURA
        bool "xiaomi sakura board"
        select MACH_XIAOMI_MSM8953
        help
          Support for Xiaomi Redmi 6 Pro

config MACH_XIAOMI_TISSOT
        bool "xiaomi tissot board"
        select MACH_XIAOMI_MSM8953
        help
          Support for Xiaomi Mi A1

config MACH_XIAOMI_VINCE
        bool "xiaomi vince board"
        select MACH_XIAOMI_MSM8953
        help
          Support for Xiaomi Redmi 5 Plus

config MACH_XIAOMI_YSL
        bool "xiaomi ysl board"
        select MACH_XIAOMI_MSM8953
        help
          Support for Xiaomi Redmi S2

endmenu
```
